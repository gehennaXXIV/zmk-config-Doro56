#include <dt-bindings/zmk/matrix_transform.h>

/ {
    left_encoder: encoder_left {
        compatible = "alps,ec11";
        label = "LEFT_ENCODER";
        resolution = <4>;
        status = "disabled";
    };

    right_encoder: encoder_right {
        compatible = "alps,ec11";
        label = "RIGHT_ENCODER";
        resolution = <4>;
        status = "disabled";
    };

    sensors {
        compatible = "zmk,keymap-sensors";
        sensors = <&left_encoder &right_encoder>;
    };
};