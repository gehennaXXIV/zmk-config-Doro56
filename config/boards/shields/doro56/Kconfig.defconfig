## config/boards/shields/doro56/Kconfig.defconfig
```kconfig
if SHIELD_DORO56_LEFT

config ZMK_KEYBOARD_NAME
    default "Doro56"

config ZMK_SPLIT_ROLE_CENTRAL
    default y

endif

if SHIELD_DORO56_LEFT || SHIELD_DORO56_RIGHT

config ZMK_SPLIT
    default y

endif
```

## config/boards/shields/doro56/Kconfig.shield
```kconfig
config SHIELD_DORO56_LEFT
    def_bool $(shields_list_contains,doro56_left)

config SHIELD_DORO56_RIGHT
    def_bool $(shields_list_contains,doro56_right)
```
